## arch/arm64/configs/dream2lte_defconfig
```kconfig
CONFIG_KSU=y
CONFIG_KSU_DEBUG=n
CONFIG_CPU_FREQ_GOV_SCHEDUTIL=y
CONFIG_CPU_FREQ_GOV_INTERACTIVE=y
CONFIG_HZ_300=y
CONFIG_IOSCHED_CFQ=y
CONFIG_IOSCHED_DEADLINE=y
CONFIG_DEFAULT_IOSCHED="cfq"
CONFIG_ZRAM=y
CONFIG_ZSMALLOC=y
CONFIG_CRYPTO_LZ4=y
CONFIG_SAMSUNG_THERMAL_TUNER=y
CONFIG_HADES_GOVERNOR_TUNER=y
CONFIG_HADES_CHARGING_CONTROL=y
```
